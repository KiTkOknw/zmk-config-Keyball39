## config/west.yml
```yaml
manifest:
  remotes:
    - name: zmkfirmware
      url-base: https://github.com/zmkfirmware
    - name: inorichi
      url-base: https://github.com/inorichi
  projects:
    - name: zmk
      remote: zmkfirmware
      import: app/west.yml
    - name: zmk-pmw3610-driver
      remote: inorichi
      revision: main
    - name: zephyr
      revision: v3.5.0+zmk-fixes
      clone-depth: 1
      import:
        # Only enable most commonly used boards. For less common hardware one
        # may need to enable additional modules.
        name-allowlist:
          - cmsis
          - hal_nordic
          - hal_rpi_pico
          - hal_stm32
          - lvgl
          - tinycrypt
  self:
    path: config
```
